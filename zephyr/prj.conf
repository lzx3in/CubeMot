## CMakeLists.txt
```
cmake_minimum_required(VERSION 3.20.0)
find_package(Zephyr REQUIRED HINTS $ENV{ZEPHYR_BASE})
project(cubemot)

target_sources(app PRIVATE
    ${CMAKE_CURRENT_SOURCE_DIR}/src/main.c
    ${CMAKE_CURRENT_SOURCE_DIR}/src/led_driver.c
    ${CMAKE_CURRENT_SOURCE_DIR}/src/button_driver.c
    ${CMAKE_CURRENT_SOURCE_DIR}/src/common_time.c

    ${CMAKE_CURRENT_SOURCE_DIR}/src/modules/blink.c
    ${CMAKE_CURRENT_SOURCE_DIR}/src/modules/led_controller.c
    ${CMAKE_CURRENT_SOURCE_DIR}/src/modules/button_detector.c

    ${CMAKE_SOURCE_DIR}/../src/msghub/msghub_state.c
    ${CMAKE_SOURCE_DIR}/../src/msghub/msghub_topic.c
    ${CMAKE_SOURCE_DIR}/../src/msghub/msghub_pub.c
    ${CMAKE_SOURCE_DIR}/../src/msghub/msghub_sub.c

    ${CMAKE_SOURCE_DIR}/../src/topics/topics.c
    ${CMAKE_SOURCE_DIR}/../src/app/app_init.c
    ${CMAKE_SOURCE_DIR}/../src/libs/pid/pid.c
    ${CMAKE_SOURCE_DIR}/../src/libs/crc/crc.c
)

target_include_directories(app PRIVATE
    ${CMAKE_CURRENT_SOURCE_DIR}/src
    ${CMAKE_SOURCE_DIR}/../src/msghub/include
    ${CMAKE_SOURCE_DIR}/../src/topics/include
    ${CMAKE_SOURCE_DIR}/../src/common/include
    ${CMAKE_SOURCE_DIR}/../src/app
    ${CMAKE_SOURCE_DIR}/../src/libs/pid
    ${CMAKE_SOURCE_DIR}/../src/libs/crc
)
```

## Kconfig
```
mainmenu "CubeMot Zephyr Configuration"

config MODULE_BLINK
    bool "Blink Module"
    default y

config MODULE_LED_CONTROLLER
    bool "LED Controller Module"
    default y

config MODULE_BUTTON_DETECTOR
    bool "Button Detector Module"
    default y
```

## prj.conf
```kconfig
CONFIG_MULTITHREADING=y
CONFIG_MAIN_THREAD_PRIORITY=0
CONFIG_MAIN_STACK_SIZE=1024
CONFIG_GPIO=y
CONFIG_PRINTK=y
CONFIG_LOG=n
CONFIG_COMPILER_OPT="-Wall"
```

## boards/nucleo_g431rb.overlay
```dts
/ {
    aliases {
        led0 = &green_led_2;
    };
};

&gpioc {
    button0: button0 {
        gpios = <&gpioc 13 (GPIO_PULL_UP | GPIO_ACTIVE_LOW)>;
        label = "User Button B1";
    };
};
```

## src/main.c
```c
#include "app.h"
#include <zephyr/kernel.h>

int main(void)
{
    if (app_init() != 0) {
        for (;;) {
            k_msleep(1000);
        }
    }
    if (app_start() != 0) {
        for (;;) {
            k_msleep(1000);
        }
    }
    return 0;
}
```

## src/button_driver.c
```c
#include "button_driver.h"
#include <zephyr/drivers/gpio.h>
#include <zephyr/devicetree.h>

#define BUTTON0_NODE DT_NODELABEL(button0)

static const struct gpio_dt_spec g_button_specs[] = {
    [0] = GPIO_DT_SPEC_GET_OR(BUTTON0_NODE, gpios, {0}),
};

static struct gpio_callback g_button_callbacks[1];
static button_callback_t g_user_callbacks[1];

static void button_isr_handler(const struct device *dev, struct gpio_callback *cb, uint32_t pins)
{
    (void)dev;
    (void)pins;
    for (int i = 0; i < 1; i++) {
        if (cb == &g_button_callbacks[i] && g_user_callbacks[i]) {
            g_user_callbacks[i](NULL);
        }
    }
}

int button_init(uint8_t button_id, button_callback_t callback)
{
    if (button_id >= 1 || g_button_specs[button_id].port == NULL)
        return -1;
    int ret = gpio_pin_configure_dt(&g_button_specs[button_id], GPIO_INPUT);
    if (ret < 0)
        return ret;
    ret = gpio_pin_interrupt_configure_dt(&g_button_specs[button_id], GPIO_INT_EDGE_TO_ACTIVE);
    if (ret < 0)
        return ret;
    g_user_callbacks[button_id] = callback;
    gpio_init_callback(&g_button_callbacks[button_id], button_isr_handler, BIT(g_button_specs[button_id].pin));
    gpio_add_callback(g_button_specs[button_id].port, &g_button_callbacks[button_id]);
    return 0;
}
```

## src/button_driver.h
```c
#pragma once
#include <stdint.h>
typedef void (*button_callback_t)(void *ctx);
int button_init(uint8_t button_id, button_callback_t callback);
```

## src/common_time.c
```c
#include "common_time.h"
#include <zephyr/kernel.h>
uint32_t common_get_timestamp_ms(void)
{
    return (uint32_t)k_uptime_get();
}
uint32_t common_get_timestamp_ms_isr(void)
{
    return (uint32_t)k_uptime_get();
}
```

## src/common_time.h
```c
#pragma once
#include <stdint.h>
uint32_t common_get_timestamp_ms(void);
uint32_t common_get_timestamp_ms_isr(void);
```

## src/led_driver.c
```c
#include "led_driver.h"
#include <zephyr/drivers/gpio.h>
#include <zephyr/devicetree.h>

#define LED0_NODE DT_ALIAS(led0)

static const struct gpio_dt_spec g_led_specs[] = {
    [0] = GPIO_DT_SPEC_GET_OR(LED0_NODE, gpios, {0}),
};

int led_on(uint8_t led_id)
{
    if (led_id >= 1 || g_led_specs[led_id].port == NULL)
        return -1;
    return gpio_pin_set_dt(&g_led_specs[led_id], 1);
}

int led_off(uint8_t led_id)
{
    if (led_id >= 1 || g_led_specs[led_id].port == NULL)
        return -1;
    return gpio_pin_set_dt(&g_led_specs[led_id], 0);
}

int led_toggle(uint8_t led_id)
{
    if (led_id >= 1 || g_led_specs[led_id].port == NULL)
        return -1;
    return gpio_pin_toggle_dt(&g_led_specs[led_id]);
}

int led_init(void)
{
    for (int i = 0; i < 1; i++) {
        if (g_led_specs[i].port == NULL)
            continue;
        int ret = gpio_pin_configure_dt(&g_led_specs[i], GPIO_OUTPUT_INACTIVE);
        if (ret < 0)
            return ret;
    }
    return 0;
}
```

## src/led_driver.h
```c
#pragma once
#include <stdint.h>
#include <stdbool.h>
#include "common_device.h"

static inline bool cubemot_device_led_is_valid(cubemot_device_led id)
{
    return id >= 0 && id < CUBEMOT_DEVICE_LED_COUNT;
}

int led_init(void);
int led_on(uint8_t led_id);
int led_off(uint8_t led_id);
int led_toggle(uint8_t led_id);
```
