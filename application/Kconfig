## application/Kconfig
```kconfig
menu "Application Configuration"

menu "Motor Control"

config APP_MOTOR_CONTROL_ENABLE
    bool "Motor Control Application"
    default y
    help
        Enable motor control application

config APP_MOTOR_TYPE
    int "Motor Type"
    default 1
    range 1 3
    depends on APP_MOTOR_CONTROL_ENABLE
    help
        Motor type: 1=BLDC, 2=PMSM, 3=ACIM

config APP_CONTROL_MODE
    int "Control Mode"
    default 0
    range 0 2
    depends on APP_MOTOR_CONTROL_ENABLE
    help
        Control mode: 0=Speed, 1=Torque, 2=Position

endmenu

menu "User Interface"

config APP_UI_ENABLE
    bool "User Interface"
    default n
    help
        Enable user interface support

choice
    prompt "UI Type"
    depends on APP_UI_ENABLE
    default APP_UI_SERIAL

config APP_UI_SERIAL
    bool "Serial Console"
    help
        Use serial console as user interface

config APP_UI_DISPLAY
    bool "LCD Display"
    help
        Use LCD display as user interface

endchoice

endmenu

menu "Diagnostics"

config APP_DIAG_ENABLE
    bool "Diagnostics"
    default y
    help
        Enable diagnostic features

config APP_DIAG_LED_HEARTBEAT
    bool "LED Heartbeat"
    default y
    depends on APP_DIAG_ENABLE
    help
        Enable LED heartbeat indicator

endmenu

endmenu
```

## boards/Kconfig
```kconfig
menu "Board Selection"

choice
    prompt "Target Board"
    default BOARD_NUCLEO_G431RB
    help
        Select the target development board

config BOARD_NUCLEO_G431RB
    bool "NUCLEO-G431RB"
    select MCU_STM32G4
    help
        STM32 NUCLEO-G431RB development board

endchoice

# Load board-specific configuration based on selection
if BOARD_NUCLEO_G431RB
source "boards/nucleo_g431rb/Kconfig"
endif

endmenu
```

## drivers/Kconfig
```kconfig
menu "Driver Configuration"

menu "UART Drivers"

config DRIVER_UART_ENABLE
    bool "UART Driver Support"
    default y
    help
        Enable UART driver framework

config DRIVER_UART1_ENABLE
    bool "UART1"
    default n
    depends on DRIVER_UART_ENABLE
    help
        Enable UART1 peripheral

config DRIVER_UART2_ENABLE
    bool "UART2"
    default n
    depends on DRIVER_UART_ENABLE
    help
        Enable UART2 peripheral

endmenu

menu "SPI Drivers"

config DRIVER_SPI_ENABLE
    bool "SPI Driver Support"
    default n
    help
        Enable SPI driver framework

config DRIVER_SPI1_ENABLE
    bool "SPI1"
    default n
    depends on DRIVER_SPI_ENABLE
    help
        Enable SPI1 peripheral

endmenu

menu "I2C Drivers"

config DRIVER_I2C_ENABLE
    bool "I2C Driver Support"
    default n
    help
        Enable I2C driver framework

config DRIVER_I2C1_ENABLE
    bool "I2C1"
    default n
    depends on DRIVER_I2C_ENABLE
    help
        Enable I2C1 peripheral

endmenu

menu "Timer Drivers"

config DRIVER_TIMER_ENABLE
    bool "Timer Driver Support"
    default n
    help
        Enable Timer driver framework

endmenu

endmenu
```

## middlewares/Kconfig
```kconfig
menu "Middleware Configuration"

menu "RTOS"

config MW_RTOS_ENABLE
    bool "RTOS Support"
    default n
    help
        Enable Real-Time Operating System

choice
    prompt "RTOS Selection"
    depends on MW_RTOS_ENABLE
    default MW_RTOS_FREERTOS

config MW_RTOS_FREERTOS
    bool "FreeRTOS"
    help
        Use FreeRTOS as the RTOS

config MW_RTOS_THREADX
    bool "ThreadX"
    help
        Use ThreadX as the RTOS

endchoice

endmenu

menu "Communication Protocols"

config MW_PROTOCOL_MODBUS
    bool "Modbus Protocol"
    default n
    help
        Enable Modbus communication protocol support

config MW_PROTOCOL_CANOPEN
    bool "CANopen Protocol"
    default n
    help
        Enable CANopen protocol support

endmenu

menu "Data Management"

config MW_DATA_LOGGER
    bool "Data Logger"
    default n
    help
        Enable data logging functionality

config MW_PARAMETER_STORE
    bool "Parameter Store"
    default n
    help
        Enable persistent parameter storage

endmenu

endmenu
```
