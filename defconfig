## src/boards/nucleo_g431rb/Kconfig
```kconfig
menu "NUCLEO-G431RB Board Configuration"

config BOARD_NAME
    string "Board Name"
    default "NUCLEO_G431RB"

menu "LED Hardware Binding"
    depends on DRIVER_LED_COUNT > 0

config BOARD_LED0_PORT_GPIOA
    bool "LED0 GPIOA"
    default y

config BOARD_LED0_PORT_GPIOB
    bool "LED0 GPIOB"

config BOARD_LED0_PORT_GPIOC
    bool "LED0 GPIOC"

config BOARD_LED0_PORT
    int
    default 0 if BOARD_LED0_PORT_GPIOA
    default 1 if BOARD_LED0_PORT_GPIOB
    default 2 if BOARD_LED0_PORT_GPIOC
    default 3

config BOARD_LED0_PIN
    int "LED0 GPIO Pin Number"
    default 5
    range 0 15

config BOARD_HAS_LED0
    bool "LED0 Hardware Present"
    default y if HAS_DRIVER_LED_0
    help
        LED0 hardware is bound on this board.
        Controlled by DRIVER_LED_0 Kconfig option.

config BOARD_LED1_PORT_GPIOA
    bool "LED1 GPIOA"
    default y

config BOARD_LED1_PORT_GPIOB
    bool "LED1 GPIOB"

config BOARD_LED1_PORT_GPIOC
    bool "LED1 GPIOC"

config BOARD_LED1_PORT
    int
    default 0 if BOARD_LED1_PORT_GPIOA
    default 1 if BOARD_LED1_PORT_GPIOB
    default 2 if BOARD_LED1_PORT_GPIOC
    default 3

config BOARD_LED1_PIN
    int "LED1 GPIO Pin Number"
    default 10
    range 0 15

config BOARD_HAS_LED1
    bool "LED1 Hardware Present"
    default n
    help
        LED1 hardware is bound on this board.
        Controlled by DRIVER_LED_1 Kconfig option.

config BOARD_LED2_PORT_GPIOA
    bool "LED2 GPIOA"
    default y

config BOARD_LED2_PORT_GPIOB
    bool "LED2 GPIOB"

config BOARD_LED2_PORT_GPIOC
    bool "LED2 GPIOC"

config BOARD_LED2_PORT
    int
    default 0 if BOARD_LED2_PORT_GPIOA
    default 1 if BOARD_LED2_PORT_GPIOB
    default 2 if BOARD_LED2_PORT_GPIOC
    default 3

config BOARD_LED2_PIN
    int "LED2 GPIO Pin Number"
    default 15
    range 0 15

config BOARD_HAS_LED2
    bool "LED2 Hardware Present"
    default n
    help
        LED2 hardware is bound on this board.
        Controlled by DRIVER_LED_2 Kconfig option.

endmenu

menu "Button Hardware Binding"
    depends on DRIVER_BUTTON_COUNT > 0

config BOARD_BUTTON0_PORT_GPIOA
    bool "Button0 GPIOA"
    default n

config BOARD_BUTTON0_PORT_GPIOB
    bool "Button0 GPIOB"
    default n

config BOARD_BUTTON0_PORT_GPIOC
    bool "Button0 GPIOC"
    default y

config BOARD_BUTTON0_PORT
    int
    default 0 if BOARD_BUTTON0_PORT_GPIOA
    default 1 if BOARD_BUTTON0_PORT_GPIOB
    default 2 if BOARD_BUTTON0_PORT_GPIOC
    default 3

config BOARD_BUTTON0_PIN
    int "Button0 GPIO Pin Number"
    default 13
    range 0 15

config BOARD_BUTTON0_IRQn_EXTI0
    bool "Button0 EXTI0"
    default n

config BOARD_BUTTON0_IRQn_EXTI1
    bool "Button0 EXTI1"
    default n

config BOARD_BUTTON0_IRQn_EXTI2
    bool "Button0 EXTI2"
    default n

config BOARD_BUTTON0_IRQn_EXTI3
    bool "Button0 EXTI3"
    default n

config BOARD_BUTTON0_IRQn_EXTI4
    bool "Button0 EXTI4"
    default n

config BOARD_BUTTON0_IRQn_EXTI9_5
    bool "Button0 EXTI9_5"
    default n

config BOARD_BUTTON0_IRQn_EXTI15_10
    bool "Button0 EXTI15_10"
    default y

config BOARD_BUTTON0_IRQn
    int
    default 6 if BOARD_BUTTON0_IRQn_EXTI0       # EXTI0_IRQn
    default 7 if BOARD_BUTTON0_IRQn_EXTI1       # EXTI1_IRQn
    default 8 if BOARD_BUTTON0_IRQn_EXTI2       # EXTI2_IRQn
    default 9 if BOARD_BUTTON0_IRQn_EXTI3       # EXTI3_IRQn
    default 10 if BOARD_BUTTON0_IRQn_EXTI4      # EXTI4_IRQn
    default 23 if BOARD_BUTTON0_IRQn_EXTI9_5    # EXTI9_5_IRQn
    default 40 if BOARD_BUTTON0_IRQn_EXTI15_10  # EXTI15_10_IRQn
    default 40

config BOARD_HAS_BUTTON0
    bool "Button0 Hardware Present"
    default y if HAS_DRIVER_BUTTON_0
    help
        Button0 hardware is bound on this board.
        Controlled by DRIVER_BUTTON_0 Kconfig option.

config BOARD_BUTTON1_PORT_GPIOA
    bool "Button1 GPIOA"
    default n

config BOARD_BUTTON1_PORT_GPIOB
    bool "Button1 GPIOB"
    default n

config BOARD_BUTTON1_PORT_GPIOC
    bool "Button1 GPIOC"
    default n

config BOARD_BUTTON1_PORT
    int
    default 0 if BOARD_BUTTON1_PORT_GPIOA
    default 1 if BOARD_BUTTON1_PORT_GPIOB
    default 2 if BOARD_BUTTON1_PORT_GPIOC
    default 3

config BOARD_BUTTON1_PIN
    int "Button1 GPIO Pin Number"
    default 0
    range 0 15

config BOARD_BUTTON1_IRQn_EXTI0
    bool "Button1 EXTI0"
    default y

config BOARD_BUTTON1_IRQn_EXTI1
    bool "Button1 EXTI1"
    default n

config BOARD_BUTTON1_IRQn_EXTI2
    bool "Button1 EXTI2"
    default n

config BOARD_BUTTON1_IRQn_EXTI3
    bool "Button1 EXTI3"
    default n

config BOARD_BUTTON1_IRQn_EXTI4
    bool "Button1 EXTI4"
    default n

config BOARD_BUTTON1_IRQn_EXTI9_5
    bool "Button1 EXTI9_5"
    default n

config BOARD_BUTTON1_IRQn_EXTI15_10
    bool "Button1 EXTI15_10"
    default n

config BOARD_BUTTON1_IRQn
    int
    default 6 if BOARD_BUTTON1_IRQn_EXTI0       # EXTI0_IRQn
    default 7 if BOARD_BUTTON1_IRQn_EXTI1       # EXTI1_IRQn
    default 8 if BOARD_BUTTON1_IRQn_EXTI2       # EXTI2_IRQn
    default 9 if BOARD_BUTTON1_IRQn_EXTI3       # EXTI3_IRQn
    default 10 if BOARD_BUTTON1_IRQn_EXTI4      # EXTI4_IRQn
    default 23 if BOARD_BUTTON1_IRQn_EXTI9_5    # EXTI9_5_IRQn
    default 40 if BOARD_BUTTON1_IRQn_EXTI15_10  # EXTI15_10_IRQn
    default 6

config BOARD_HAS_BUTTON1
    bool "Button1 Hardware Present"
    default n
    help
        Button1 hardware is bound on this board.
        Controlled by DRIVER_BUTTON_1 Kconfig option.

config BOARD_BUTTON2_PORT_GPIOA
    bool "Button2 GPIOA"
    default n

config BOARD_BUTTON2_PORT_GPIOB
    bool "Button2 GPIOB"
    default n

config BOARD_BUTTON2_PORT_GPIOC
    bool "Button2 GPIOC"
    default n

config BOARD_BUTTON2_PORT
    int
    default 0 if BOARD_BUTTON2_PORT_GPIOA
    default 1 if BOARD_BUTTON2_PORT_GPIOB
    default 2 if BOARD_BUTTON2_PORT_GPIOC
    default 3

config BOARD_BUTTON2_PIN
    int "Button2 GPIO Pin Number"
    default 0
    range 0 15

config BOARD_BUTTON2_IRQn_EXTI0
    bool "Button2 EXTI0"
    default n

config BOARD_BUTTON2_IRQn_EXTI1
    bool "Button2 EXTI1"
    default n

config BOARD_BUTTON2_IRQn_EXTI2
    bool "Button2 EXTI2"
    default n

config BOARD_BUTTON2_IRQn_EXTI3
    bool "Button2 EXTI3"
    default n

config BOARD_BUTTON2_IRQn_EXTI4
    bool "Button2 EXTI4"
    default n

config BOARD_BUTTON2_IRQn_EXTI9_5
    bool "Button2 EXTI9_5"
    default n

config BOARD_BUTTON2_IRQn_EXTI15_10
    bool "Button2 EXTI15_10"
    default n

config BOARD_BUTTON2_IRQn
    int
    default 6 if BOARD_BUTTON2_IRQn_EXTI0       # EXTI0_IRQn
    default 7 if BOARD_BUTTON2_IRQn_EXTI1       # EXTI1_IRQn
    default 8 if BOARD_BUTTON2_IRQn_EXTI2       # EXTI2_IRQn
    default 9 if BOARD_BUTTON2_IRQn_EXTI3       # EXTI3_IRQn
    default 10 if BOARD_BUTTON2_IRQn_EXTI4      # EXTI4_IRQn
    default 23 if BOARD_BUTTON2_IRQn_EXTI9_5    # EXTI9_5_IRQn
    default 40 if BOARD_BUTTON2_IRQn_EXTI15_10  # EXTI15_15_IRQn
    default 6

config BOARD_HAS_BUTTON2
    bool "Button2 Hardware Present"
    default n
    help
        Button2 hardware is bound on this board.
        Controlled by DRIVER_BUTTON_2 Kconfig option.

endmenu

endmenu
```

## src/boards/nucleo_g431rb/defconfig
```kconfig
# Nucleo-G431RB Board Configuration
CONFIG_BOARD_NAME="NUCLEO-G431RB"

# LED Driver Configuration
CONFIG_DRIVER_LED_COUNT=1
CONFIG_HAS_DRIVER_LED_0=y
CONFIG_HAS_DRIVER_LED_1=n
CONFIG_HAS_DRIVER_LED_2=n

# LED0 Hardware Binding
CONFIG_BOARD_LED0_PORT_GPIOA=y
CONFIG_BOARD_LED0_PORT=0
CONFIG_BOARD_LED0_PIN=5
```

## src/comm/serial_cmd/Kconfig
```kconfig
config MODULE_SERIAL_CMD_ENABLE
	bool "Serial Command Module"
	default y
	help
	  Enables UART serial command protocol bridge (UART ↔ msghub).
	  USART2 @ 115200 baud, binary frame protocol.

if MODULE_SERIAL_CMD_ENABLE

config SERIAL_CMD_STACK_SIZE
	int "Serial command thread stack size (bytes)"
	default 1536
	range 1024 8192
	help
	  Stack size for the unified serial command thread (RX + TX).

endif # MODULE_SERIAL_CMD_ENABLE
```

## src/drivers/button/Kconfig
```kconfig
menu "Button Driver Configuration"

config HAS_DRIVER_BUTTON_0
    bool "Button 0 resource"
    default y
    help
        Enable Button 0 resource. Board code binds hardware to this resource.

config HAS_DRIVER_BUTTON_1
    bool "Button 1 resource"
    default n
    help
        Enable Button 1 resource.

config HAS_DRIVER_BUTTON_2
    bool "Button 2 resource"
    default n
    help
        Enable Button 2 resource.

config DRIVER_BUTTON_COUNT
    int "Number of Button resources"
    default 1
    range 0 3
    help
        Total number of Button resources. Should match the number of HAS_DRIVER_BUTTON_X enabled.

endmenu
```

## src/drivers/led/Kconfig
```kconfig
menu "LED Driver Configuration"

config HAS_DRIVER_LED_0
    bool "LED 0 resource"
    default y
    help
        Enable LED 0 resource. Board code binds hardware to this resource.

config HAS_DRIVER_LED_1
    bool "LED 1 resource"
    default n
    help
        Enable LED 1 resource.

config HAS_DRIVER_LED_2
    bool "LED 2 resource"
    default n
    help
        Enable LED 2 resource.

config DRIVER_LED_COUNT
    int "Number of LED resources"
    default 1
    range 0 3
    help
        Total number of LED resources. Should match the number of HAS_DRIVER_LED_X enabled.

endmenu
```

## src/modules/Kconfig
```kconfig
menu "Modules Configuration"

# Blink Module
config MODULE_BLINK_ENABLE
    bool "Blink Module"
    default y

# Button Detector Module
config MODULE_BUTTON_DETECTOR_ENABLE
    bool "Button Detector Module"
    default y

# LED Controller Module
config MODULE_LED_CONTROLLER_ENABLE
    bool "LED Controller Module"
    default y

endmenu
```

## src/modules/commander/Kconfig
```kconfig
config MODULE_COMMANDER_ENABLE
	bool "Commander Module"
	default y
	help
	  Enables the commander module with state machine and command routing.

if MODULE_COMMANDER_ENABLE

config COMMANDER_STACK_SIZE
	int "Commander thread stack size (bytes)"
	default 2048
	range 1024 8192
	help
	  Stack size for the commander thread.

endif # MODULE_COMMANDER_ENABLE
```

## src/modules/motor_ctrl/Kconfig
```kconfig
config MODULE_MOTOR_CTRL_ENABLE
    bool "Motor Control Module"
    default y
    help
      Enables the motor control module with FOC + sensorless observer.

if MODULE_MOTOR_CTRL_ENABLE

config MOTOR_CTRL_STACK_SIZE
    int "Motor control thread stack size (bytes)"
    default 2048
    range 1024 8192
    help
      Stack size for the motor control thread.

endif # MODULE_MOTOR_CTRL_ENABLE
```

## src/modules/servo_ctrl/Kconfig
```kconfig
config MODULE_SERVO_CTRL
	bool "Enable servo control module"
	default y
	help
	  Enable PWM servo control for steering
```

## src/modules/vehicle/Kconfig
```kconfig
config MODULE_VEHICLE_ENABLE
	bool "Vehicle Kinematics Module"
	default y
	help
	  Enables vehicle kinematics (differential drive + odometry).
	  V2: 2 wheels. V3: Ackermann 4 wheels + 2 servos.

if MODULE_VEHICLE_ENABLE

config VEHICLE_STACK_SIZE
	int "Vehicle thread stack size (bytes)"
	default 2048
	range 1024 8192
	help
	  Stack size for the vehicle kinematics thread.

endif # MODULE_VEHICLE_ENABLE
```

## src/msghub/Kconfig
```kconfig
# Msghub configuration

menu "Message Hub Configuration"

config MSGHUB_MAX_TOPICS
	int "Maximum number of topics"
	default 8
	range 4 32
	help
	  Maximum number of unique topics that can be registered.

config MSGHUB_MAX_INSTANCES
	int "Maximum instances per topic"
	default 4
	range 1 16
	help
	  Maximum number of publisher instances per topic.

config MSGHUB_MAX_SUBSCRIBERS
	int "Maximum number of subscribers"
	default 16
	range 8 64
	help
	  Maximum total number of subscriber handles.

endmenu
```
